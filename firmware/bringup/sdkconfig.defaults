## firmware/bringup/sdkconfig.defaults
```kconfig
# ShrikeVault bring-up — sane defaults. (P0 is a DEBUG build: no Secure Boot /
# Flash Encryption here — those land in the release sdkconfig in P5.)

CONFIG_IDF_TARGET="esp32s3"

# --- Console over the ESP32-S3 built-in USB Serial/JTAG (the device that
#     enumerates as COM19). No external UART adapter needed. ---
CONFIG_ESP_CONSOLE_USB_SERIAL_JTAG=y
CONFIG_ESP_CONSOLE_SECONDARY_NONE=y

# --- Flash: Shrike-Fi has 8 MB QSPI ---
CONFIG_ESPTOOLPY_FLASHSIZE_8MB=y
CONFIG_ESPTOOLPY_FLASHSIZE="8MB"
CONFIG_PARTITION_TABLE_SINGLE_APP_LARGE=y

# --- Base Shrike-Fi has NO PSRAM (optional add-on). Keep it off so the build
#     reflects the stock board; flip this if you soldered the PSRAM option. ---
# CONFIG_SPIRAM=y

# --- Logging ---
CONFIG_LOG_DEFAULT_LEVEL_INFO=y
CONFIG_LOG_COLORS=y

# --- A little more main-task stack for the console + FPGA streaming buffer ---
CONFIG_ESP_MAIN_TASK_STACK_SIZE=6144

# --- FreeRTOS tick at 1 kHz so vTaskDelay(1ms) is actually ~1 ms (FPGA timing) ---
CONFIG_FREERTOS_HZ=1000
```

## firmware/shrikevault/sdkconfig.defaults
```kconfig
# shrikevault — DEBUG defaults (release build adds Secure Boot v2 + Flash
# Encryption + encrypted NVS + anti-rollback in a separate sdkconfig.release
# layer in P4).

CONFIG_IDF_TARGET="esp32s3"

# Console over the built-in USB Serial/JTAG (the device that enumerates as a COM
# port). TinyUSB CDC-ACM for the wallet wire protocol comes online later in P3.
CONFIG_ESP_CONSOLE_USB_SERIAL_JTAG=y
CONFIG_ESP_CONSOLE_SECONDARY_NONE=y

# Shrike-Fi has 8 MB QSPI flash. Use a 3-app-slot partition table so we can
# host bootloader + factory app + 2 OTA slots (anti-rollback friendly).
CONFIG_ESPTOOLPY_FLASHSIZE_8MB=y
CONFIG_ESPTOOLPY_FLASHSIZE="8MB"
CONFIG_PARTITION_TABLE_SINGLE_APP_LARGE=y

# Base Shrike-Fi has no PSRAM (optional add-on); keep it off so the build
# reflects stock hardware.
# CONFIG_SPIRAM=y

# NVS — encrypted in release builds (P4); plain in debug for development sanity.
# Plain NVS is fine for debug because we use a *throwaway* device_key during
# development (rotated frequently) — never put real funds on a debug build.
# CONFIG_NVS_ENCRYPTION=y                  # enabled in sdkconfig.release

# Larger main task stack — BIP-32 derivation + secp256k1 ops are stack-hungry.
CONFIG_ESP_MAIN_TASK_STACK_SIZE=8192

# 1 kHz tick → vTaskDelay(1ms) ≈ 1 ms (signing timing).
CONFIG_FREERTOS_HZ=1000

# Logs
CONFIG_LOG_DEFAULT_LEVEL_INFO=y
CONFIG_LOG_COLORS=y

# mbedTLS: enable HKDF (off by default in ESP-IDF's bundled mbedtls). Used by
# the bip39_bip32 component to derive BIP-39 entropy from the device_key.
CONFIG_MBEDTLS_HKDF_C=y

# Disable WiFi & Bluetooth init by default — v1 firmware does not use the radios
# at all (out-of-scope per the threat model). Save flash + reduce attack surface.
CONFIG_BT_ENABLED=n
# (WiFi is not started unless we call esp_wifi_init; nothing to disable here.)
```
